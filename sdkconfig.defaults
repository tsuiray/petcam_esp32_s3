## sdkconfig.defaults
```kconfig
# Target: run `idf.py set-target esp32s3` once after cloning.

CONFIG_ESP_MAIN_TASK_STACK_SIZE=3000
CONFIG_ESP_TASK_WDT_EN=n

# micro-ROS over Wi-Fi STA (home AP) + XRCE-DDS UDP to Orin agent
CONFIG_MICRO_ROS_ESP_XRCE_DDS_MIDDLEWARE=y
CONFIG_MICRO_ROS_ESP_NETIF_WLAN=y

# Replace these with your home AP credentials and Orin LAN IP before flash.
CONFIG_ESP_WIFI_SSID="YOUR_HOME_WIFI_SSID"
CONFIG_ESP_WIFI_PASSWORD="YOUR_HOME_WIFI_PASSWORD"
CONFIG_ESP_MAXIMUM_RETRY=5
CONFIG_MICRO_ROS_AGENT_IP="192.168.1.100"
CONFIG_MICRO_ROS_AGENT_PORT="8888"
```
